## pkgs/templar-droidspaces-kernel/gunyah-backport/drivers/virt/gunyah/Kconfig
```kconfig
# SPDX-License-Identifier: GPL-2.0-only

config GUNYAH
	tristate "Gunyah Virtualization drivers"
	depends on ARM64
	depends on KPROBES
	help
	  The Gunyah drivers are the helper interfaces that run in a guest VM
	  such as basic inter-VM IPC and signaling mechanisms, and higher level
	  services such as memory/device sharing, IRQ sharing, and so on.

	  This Android 5.10 backport reuses Qualcomm's already loaded legacy
	  gh_rm_drv transport and exposes the upstream /dev/gunyah host-VM ABI.

	  Say M here to enable the crosvm-compatible host driver.

config GUNYAH_VCPU
	tristate "Runnable Gunyah vCPUs"
	depends on GUNYAH
	help
	  Enable kernel support for host-scheduled vCPUs running under Gunyah.
	  When selecting this option, userspace virtual machine managers (VMM)
	  can schedule the guest VM's vCPUs instead of using Gunyah's scheduler.
	  VMMs can also handle stage 2 faults of the vCPUs.

	  Say Y/M here if unsure and you want to support Gunyah VMMs.

config GUNYAH_IRQFD
	tristate "Gunyah irqfd interface"
	depends on GUNYAH
	help
	  Enable kernel support for creating irqfds which can raise an interrupt
	  on Gunyah virtual machine.

	  Say Y/M here if unsure and you want to support Gunyah VMMs.

config GUNYAH_IOEVENTFD
	tristate "Gunyah ioeventfd interface"
	depends on GUNYAH
	help
	  Enable kernel support for creating ioeventfds which can alert userspace
	  when a Gunyah virtual machine accesses a memory address.

	  Say Y/M here if unsure and you want to support Gunyah VMMs.
```
